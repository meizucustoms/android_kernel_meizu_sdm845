/* Copyright (c) 2022, MeizuCustoms enthusiasts
 *
 * This program is free software; you can redistribute it and/or modify
 * it under the terms of the GNU General Public License version 2 and
 * only version 2 as published by the Free Software Foundation.
 *
 * This program is distributed in the hope that it will be useful,
 * but WITHOUT ANY WARRANTY; without even the implied warranty of
 * MERCHANTABILITY or FITNESS FOR A PARTICULAR PURPOSE.  See the
 * GNU General Public License for more details.
 */

/dts-v1/;

/ {
	qcom,rtic-id = <0x01>;
	MP_DATA = <0x2009 0x80ffffff 0x1801 0x00 0xa0050000 0xe0b01040 0x81581f85 0x15b57312 0x6b540ac7 0x9ca89509 0x2d4fb041 0x18a6d173 0x983b47f4 0x00>;
};
