/* Copyright (c) 2022, MeizuCustoms enthusiasts
 *
 * This program is free software; you can redistribute it and/or modify
 * it under the terms of the GNU General Public License version 2 and
 * only version 2 as published by the Free Software Foundation.
 *
 * This program is distributed in the hope that it will be useful,
 * but WITHOUT ANY WARRANTY; without even the implied warranty of
 * MERCHANTABILITY or FITNESS FOR A PARTICULAR PURPOSE.  See the
 * GNU General Public License for more details.
 */

/dts-v1/;

/ {
	qcom,rtic-id = <0x01>;
	MP_DATA = <0x2009 0x80ffffff 0x1801 0x00 0x38040000 0xe3f741d3 0x9c2b4b0e 0x16baeb7a 0x91edf08d 0x70ea435d 0xf8f215df 0x97d411ff 0xd8e9b21d 0x00>;
};
