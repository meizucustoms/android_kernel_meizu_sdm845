/* Copyright (c) 2017, The Linux Foundation. All rights reserved.
 * Copyright (c) 2022, MeizuCustoms enthusiasts
 *
 * This program is free software; you can redistribute it and/or modify
 * it under the terms of the GNU General Public License version 2 and
 * only version 2 as published by the Free Software Foundation.
 *
 * This program is distributed in the hope that it will be useful,
 * but WITHOUT ANY WARRANTY; without even the implied warranty of
 * MERCHANTABILITY or FITNESS FOR A PARTICULAR PURPOSE.  See the
 * GNU General Public License for more details.
 */

/dts-v1/;

#include "sdm845-v2.1.dtsi"
#include "meizu/sdm845-meizu-m1882.dtsi"

/ {
	model = "Qualcomm Technologies, Inc. SDM845 v2.1 SoC";
	compatible = "qcom,sdm845";
	qcom,msm-id = <0x141 0x20001>;
	qcom,board-id = <0 0>;
};

