/* Copyright (c) 2022, MeizuCustoms enthusiasts
 *
 * This program is free software; you can redistribute it and/or modify
 * it under the terms of the GNU General Public License version 2 and
 * only version 2 as published by the Free Software Foundation.
 *
 * This program is distributed in the hope that it will be useful,
 * but WITHOUT ANY WARRANTY; without even the implied warranty of
 * MERCHANTABILITY or FITNESS FOR A PARTICULAR PURPOSE.  See the
 * GNU General Public License for more details.
 */

/* Base DTS */
#include "../sdm845-v2.1.dtsi"

/* Overlays */
#include "../sdm845-sde-display.dtsi"
#include "../sdm845-mtp.dtsi"
#include "../sdm845-audio-overlay.dtsi"

/* Fixups */
#include "sdm845-meizu-audio.dtsi"
#include "sdm845-meizu-camera.dtsi"
#include "sdm845-meizu-display.dtsi"
#include "sdm845-meizu-dt-fstab.dtsi"
#include "sdm845-meizu-general.dtsi"
#include "sdm845-meizu-io.dtsi"
#include "sdm845-meizu-memory.dtsi"
#include "sdm845-meizu-pinctrl.dtsi"
#include "sdm845-meizu-power.dtsi"
#include "sdm845-meizu-usb.dtsi"
