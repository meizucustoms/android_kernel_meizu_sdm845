 
/* Copyright (c) 2022, MeizuCustoms enthusiasts
 *
 * This program is free software; you can redistribute it and/or modify
 * it under the terms of the GNU General Public License version 2 and
 * only version 2 as published by the Free Software Foundation.
 *
 * This program is distributed in the hope that it will be useful,
 * but WITHOUT ANY WARRANTY; without even the implied warranty of
 * MERCHANTABILITY or FITNESS FOR A PARTICULAR PURPOSE.  See the
 * GNU General Public License for more details.
 */

qcom,3511331_meizu_m1882gy_3010mah_averaged_masterslave_jun4th2018 {
    qcom,battery-name = "COSLIGHT-JIADE";
    qcom,battery-type = "3511331_meizu_m1882gy_3010mah_averaged_masterslave_jun4th2018";

    qcom, = <24>;
    qcom,max-voltage-uv = <4400000>;
    qcom,fastchg-current-ma = <2950>;
    qcom,nom-batt-capacity-mah = <3010>;
    qcom,batt-id-kohm = <100>;
    qcom,battery-beta = <3435>;
    qcom,fg-cc-cv-threshold-mv = <4390>;
    qcom,checksum = <0x111C>;
    qcom,gui-version = "PMI8998GUI - 2.0.0.58";
    qcom,fg-profile-data = 
        [16 21 fb 0d 
         9f 0b 4b 05 
         f1 1c 3d fb 
         eb 04 90 03 
         7d 17 d8 23 
         92 44 16 5a 
         8c 00 00 00 
         11 00 00 00 
         00 00 83 ba 
         0c cd d4 b4 
         33 00 08 00 
         17 e3 bd 07 
         6c 05 a5 01 
         90 15 4d fd 
         96 07 44 2b 
         28 06 09 20 
         27 00 14 00 
         6f 20 cb 04 
         0c 0b c9 05 
         e0 1c 9c 02 
         b6 0c 7f 0b 
         8e 18 de 23 
         e0 4d 3b 5b 
         75 00 00 00 
         0e 00 00 00 
         00 00 13 cc 
         5b c3 89 bb 
         23 00 00 00 
         a5 ea bd 07 
         5b 06 ce f3 
         e3 fd 60 01 
         ab 01 ec 22 
         c3 33 cc ff 
         07 10 00 00 
         08 0c 66 46 
         23 00 40 00 
         63 01 0a fa 
         ff 00 00 00 
         00 00 00 00 
         00 00 00 00 
         00 00 00 00 
         00 00 00 00 
         00 00 00 00 
         00 00 00 00 
         00 00 00 00 
         00 00 00 00 
         00 00 00 00 
         00 00 00 00 
         00 00 00 00 
         00 00 00 00 
         00 00 00 00 
         00 00 00 00 
         00 00 00 00 
         00 00 00 00 
         00 00 00 00 
         00 00 00 00];
};
