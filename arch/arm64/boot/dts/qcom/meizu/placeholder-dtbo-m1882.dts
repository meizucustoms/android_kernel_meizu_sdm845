/* Copyright (c) 2022, MeizuCustoms enthusiasts
 *
 * This program is free software; you can redistribute it and/or modify
 * it under the terms of the GNU General Public License version 2 and
 * only version 2 as published by the Free Software Foundation.
 *
 * This program is distributed in the hope that it will be useful,
 * but WITHOUT ANY WARRANTY; without even the implied warranty of
 * MERCHANTABILITY or FITNESS FOR A PARTICULAR PURPOSE.  See the
 * GNU General Public License for more details.
 */

/dts-v1/;
/plugin/;

/* This node was created to fill out __fixups__ and __symbols__ nodes */
/* (bootloader doesn't like empty dtbo) */

&soc {
    placeholder_node_forget_about_it: placeholder-forget-about-it {
        compatible = "placeholder,forget-about-it";
    };
};

/ {
	model = "MeizuSucks OSC project, Meizu 16th (DTBO)";
	compatible = 
		"qcom,sdm845-mtp", 
		"qcom,sdm845", 
		"qcom,mtp", 
		"meizu,sdm845", 
		"meizu,m1882";
	qcom,msm-id = <321 0x20001>;
	qcom,board-id = <8 0>;
};
